## boards/shields/falcon_dongle/Kconfig.defconfig
```kconfig
if SHIELD_FALCON_DONGLE

config ZMK_KEYBOARD_NAME
    default "Falcon"

config ZMK_SPLIT_ROLE_CENTRAL
    default y

config ZMK_SPLIT
    default y

# 2 peripherals: left half + right half
config ZMK_SPLIT_BLE_CENTRAL_PERIPHERALS
    default 2

# BT_MAX_CONN = peripherals + desired BT profiles (default 5)
config BT_MAX_CONN
    default 7

config BT_MAX_PAIRED
    default 7

config ZMK_POINTING
    default y

endif
```

## boards/shields/falcon_left/Kconfig.defconfig
```kconfig
if SHIELD_FALCON_LEFT

config ZMK_KEYBOARD_NAME
    default "Falcon Left"

config ZMK_SPLIT
    default y

endif
```

## boards/shields/falcon_right/Kconfig.defconfig
```kconfig
if SHIELD_FALCON_RIGHT

config ZMK_KEYBOARD_NAME
    default "Falcon Right"

config ZMK_SPLIT
    default y

config ZMK_POINTING
    default y

config SPI
    default y

endif
```

## config/west.yml
```yaml
manifest:
  remotes:
    - name: zmkfirmware
      url-base: https://github.com/zmkfirmware
    - name: badjeff
      url-base: https://github.com/badjeff

  projects:
    - name: zmk
      remote: zmkfirmware
      revision: main
      import: app/west.yml

    # PMW3610 trackball driver
    - name: zmk-pmw3610-driver
      remote: badjeff
      revision: main

    # Relay trackball input events from right peripheral to dongle central
    - name: zmk-split-peripheral-input-relay
      remote: badjeff
      revision: main

  self:
    path: config
```
