/*
 * falcon.dtsi - Shared devicetree config included by both falcon_right and falcon_dongle
 *
 * Defines the zmk,input-split node and a disabled input listener.
 * The peripheral assigns the real trackball device to the split.
 * The central enables the listener.
 */

#include <zephyr/dt-bindings/input/input-event-codes.h>

/ {
    split_inputs {
        #address-cells = <1>;
        #size-cells = <0>;

        trackball_split: trackball_split@0 {
            compatible = "zmk,input-split";
            reg = <0>;
        };
    };

    /* Disabled by default so keymap includes on peripheral don't fail */
    trackball_listener: trackball_listener {
        compatible = "zmk,input-listener";
        status = "disabled";
        device = <&trackball_split>;
    };
};
